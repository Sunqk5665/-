/**************************************************************************************
**名称：定时器实验
**功能：由单片机内部定时器1，按方式1工作，即作为16位定时器使用每0.05秒钟T1溢出中断一次。
		P1口的P1.0-P1.7分别接八个发光二极管。编写程序模拟一时序控制装置。上电后第一秒钟
		L1，L3亮	，第二秒钟L2，L4亮，第三秒钟L5，L7亮，第四秒钟L6，L8亮，第五秒L1，
		L3，L5，L7亮，第六秒	钟L2，L4，L6，L8亮，第七秒钟八个二极管全亮，第八秒钟全
		灭，以后又从头开始，L1，L3亮，	然后L2，L4亮......一直循环下去。
**时间：2017.3.8
*************************************************************************************/
#include<reg52.h>

unsigned char nCount,flog;
unsigned char code tab[]={0x05,0x0a,0x50,0xa0,0x55,0xaa,0xff,0x00};
void init();
void main()
{
	unsigned char i;
	P1=0x00;
	init();
	while(1)
	{
		if(flog==1)
		{
			P1=tab[i++];
			if(i==8)
				i=0;
			flog=0;
		}
			
	}
}

void init()
{
	TMOD=0x10;
	TH0=0x3c;
	TL0=0xb0;
	EA=1;
	ET1=1;
	TR1=1;
}

void time1() interrupt 3
{
	TH0=0x3c;
	TL0=0xb0;
	nCount++;
	if(nCount==20)
	{
		nCount=0;
		flog=1;
	}
}